## drivers/misc/mediatek/sensor/2.0/mtk_nanohub/Kconfig
```kconfig
# SPDX-License-Identifier: GPL-2.0

config CUSTOM_KERNEL_SENSORHUB
	tristate "CUSTOM KERNEL SENSORHUB support"
	help
	  Kernel space sensor hub driver.
	  Define project used all sensor hub
	  sensors. The value is combination of sensor hub driver(get data...etc)
	  and sensor hub framework driver(transmit shf info)

config CUSTOM_KERNEL_ALS_MULTI_CALI_SUPPORT
	bool "multi_cali for MediaTek package"
	help
	  It support multi_cali.
	  If this option is set,
	  it will support
	  multi_cali.

config CUSTOM_KERNEL_SCP_BUMP_UP
	bool "set scp in a higher mips for ARES"
	help
	  It support ares set scp to a higher mips.

config CUSTOM_KERNEL_CCT
	bool "cct_cali for MediaTek package"
	help
	  It support cct_cali.
	  If this option is set,
	  it will support
	  cct_cali.

source "drivers/misc/mediatek/sensor/2.0/mtk_nanohub/nanohub/Kconfig"
```

## drivers/misc/mediatek/typec/Kconfig
```kconfig
#
# MediaTek USB TYPEC Driver
#

config MTK_USB_TYPEC
	tristate "Mediatek USB TYPE-C Driver"
	help
	  Enables to support usb-c. So the usb device and host driver register
	  the callback func to the usb-c driver. When the usb-c driver detect
	  a device/host plugged in/out, it will notify the device/host driver
	  by callback func.
	  If unsure, say N.

source "drivers/misc/mediatek/typec/tcpc/Kconfig"

source "drivers/misc/mediatek/typec/mux/Kconfig"

config OCP96011_I2C
	tristate "analog audio switch"
	depends on I2C
	help
	  The OCP96011 is a high-performance USB Type-C port
	  multimedia switch. The OCP96011 supports USB2.0
	  signal, analog audio, sideband use wires and analog
	  microphone signal.
config AGATE_CHARGER
	bool "MTK charger for AGATE"
	help
	  Say yes In MTK charger AGATE.

config ARES_CHARGER
	bool "MTK charger for ARES"
	help
	  Say yes In MTK charger ARES.
source "drivers/misc/mediatek/typec/tcpc/Kconfig"
source "drivers/misc/mediatek/typec/tcpc_agate/Kconfig"
```
