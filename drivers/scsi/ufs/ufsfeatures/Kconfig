## drivers/scsi/ufs/ufsfeatures/Kconfig
```kconfig
#
# Kernel configuration file for Xiaomi UFS features.
#

config CLD
       bool "UFS CLD"
       depends on SCSI_UFSHCD  && SCSI_UFS_FEATURE
       default n
       ---help---
	UFS CLD Feature Enable
```
